## conf/layer.conf
```bitbake
# We have a conf and classes directory, add to BBPATH
BBPATH .= ":${LAYERDIR}"

# We have recipes-* directories, add to BBFILES
BBFILES += "${LAYERDIR}/recipes-*/*/*.bb \
            ${LAYERDIR}/recipes-*/*/*.bbappend"

BBFILE_COLLECTIONS += "meta-test-image"
BBFILE_PATTERN_meta-test-image = "^${LAYERDIR}/"
BBFILE_PRIORITY_meta-test-image = "6"

LAYERDEPENDS_meta-test-image = "core"
LAYERSERIES_COMPAT_meta-test-image = "warrior zeus dunfell"
```

## container/home/yocto/meta-asterisk/conf/layer.conf
```bitbake
# We have a conf and classes directory, add to BBPATH
BBPATH .= ":${LAYERDIR}"

# We have recipes-* directories, add to BBFILES
BBFILES += "${LAYERDIR}/recipes-*/*/*.bb \
            ${LAYERDIR}/recipes-*/*/*.bbappend"

BBFILE_COLLECTIONS += "meta-asterisk"
BBFILE_PATTERN_meta-asterisk = "^${LAYERDIR}/"
BBFILE_PRIORITY_meta-asterisk = "6"

LAYERDEPENDS_meta-asterisk = "core"
LAYERSERIES_COMPAT_meta-asterisk = "kirkstone"
```

## container/home/yocto/meta-custom-image/conf/layer.conf
```bitbake
# We have a conf and classes directory, add to BBPATH
BBPATH .= ":${LAYERDIR}"

# We have recipes-* directories, add to BBFILES
BBFILES += "${LAYERDIR}/recipes-*/*/*.bb \
            ${LAYERDIR}/recipes-*/*/*.bbappend"

BBFILE_COLLECTIONS += "meta-custom-image"
BBFILE_PATTERN_meta-custom-image = "^${LAYERDIR}/"
BBFILE_PRIORITY_meta-custom-image = "20"

LAYERDEPENDS_meta-custom-image = "core"
LAYERSERIES_COMPAT_meta-custom-image = "dunfell"
```
